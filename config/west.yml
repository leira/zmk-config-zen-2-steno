## config/west.yml
```yaml
manifest:
  remotes:
    - name: zmkfirmware
      url-base: https://github.com/leira
  projects:
    - name: zmk
      remote: zmkfirmware
      revision: corne-ish-zen
      import: app/west.yml
  self:
    path: config
```
